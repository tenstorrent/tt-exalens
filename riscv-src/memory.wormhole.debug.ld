/*
 * SPDX-FileCopyrightText: (c) 2024 Tenstorrent AI ULC
 *
 * SPDX-License-Identifier: Apache-2.0
 */

LDM_BASE = 0xFFB00000;
BRISC_LDM_LENGTH = 4K;
TRISC_LDM_LENGTH = 2K;
NCRISC_LDM_LENGTH = 4K;
ERISC_LDM_LENGTH = 4K;

L1_BASE = 0x0;
UNDEFINED = 0;

/* Each core's L1 block is [CODE][LOCAL_DATA][GCOV][THREAD_LOCAL], laid out back
 * to back. THREAD_LOCAL backs `thread_local` variables - a fixed, in-range
 * scratch/mailbox window the host can address. The groups are:
 *
 *   Tensix: [BRISC] [TRISCs] [NCRISC] (...) [LDM]
 *   ETH:    [ERISC] (...) [LDM]
 *
 * LOADER_INIT regions are undefined for every core, as no data is in LDM.
 * LOADER_CODE regions are undefined for every core, as no code is in IMEM.
 * LOCAL_DATA and CODE regions are spacious because of instrumentation and less optimized kernels.
 * NCRISC gets its code in L1 as well, to avoid the eventuality of IMEM overflow for the same reasons.
 * LDM (private memory) is only used for the stack.
 */

MEMORY
{
    /* Private memory layout for each core */
    BRISC_STACK_MEM         : ORIGIN = LDM_BASE, LENGTH = BRISC_LDM_LENGTH
    TRISC0_STACK_MEM        : ORIGIN = LDM_BASE, LENGTH = TRISC_LDM_LENGTH
    TRISC1_STACK_MEM        : ORIGIN = LDM_BASE, LENGTH = TRISC_LDM_LENGTH
    TRISC2_STACK_MEM        : ORIGIN = LDM_BASE, LENGTH = TRISC_LDM_LENGTH
    NCRISC_STACK_MEM        : ORIGIN = LDM_BASE, LENGTH = NCRISC_LDM_LENGTH
    ERISC_STACK_MEM         : ORIGIN = LDM_BASE, LENGTH = ERISC_LDM_LENGTH


    /* L1 layout. Each core's block ends with its THREAD_LOCAL region. */
    BRISC_CODE              : ORIGIN = L1_BASE, LENGTH = 48K
    BRISC_LOCAL_DATA_MEM    : ORIGIN = ORIGIN(BRISC_CODE) + LENGTH(BRISC_CODE), LENGTH = 32K
    BRISC_GCOV_MEM          : ORIGIN = ORIGIN(BRISC_LOCAL_DATA_MEM) + LENGTH(BRISC_LOCAL_DATA_MEM), LENGTH = 8K
    BRISC_THREAD_LOCAL_MEM  : ORIGIN = ORIGIN(BRISC_GCOV_MEM) + LENGTH(BRISC_GCOV_MEM), LENGTH = 32K

    TRISC0_CODE             : ORIGIN = ORIGIN(BRISC_THREAD_LOCAL_MEM) + LENGTH(BRISC_THREAD_LOCAL_MEM), LENGTH = 48K
    TRISC0_LOCAL_DATA_MEM   : ORIGIN = ORIGIN(TRISC0_CODE) + LENGTH(TRISC0_CODE), LENGTH = 32K
    TRISC0_GCOV_MEM         : ORIGIN = ORIGIN(TRISC0_LOCAL_DATA_MEM) + LENGTH(TRISC0_LOCAL_DATA_MEM), LENGTH = 8K
    TRISC0_THREAD_LOCAL_MEM : ORIGIN = ORIGIN(TRISC0_GCOV_MEM) + LENGTH(TRISC0_GCOV_MEM), LENGTH = 32K

    TRISC1_CODE             : ORIGIN = ORIGIN(TRISC0_THREAD_LOCAL_MEM) + LENGTH(TRISC0_THREAD_LOCAL_MEM), LENGTH = 48K
    TRISC1_LOCAL_DATA_MEM   : ORIGIN = ORIGIN(TRISC1_CODE) + LENGTH(TRISC1_CODE), LENGTH = 32K
    TRISC1_GCOV_MEM         : ORIGIN = ORIGIN(TRISC1_LOCAL_DATA_MEM) + LENGTH(TRISC1_LOCAL_DATA_MEM), LENGTH = 8K
    TRISC1_THREAD_LOCAL_MEM : ORIGIN = ORIGIN(TRISC1_GCOV_MEM) + LENGTH(TRISC1_GCOV_MEM), LENGTH = 32K

    TRISC2_CODE             : ORIGIN = ORIGIN(TRISC1_THREAD_LOCAL_MEM) + LENGTH(TRISC1_THREAD_LOCAL_MEM), LENGTH = 48K
    TRISC2_LOCAL_DATA_MEM   : ORIGIN = ORIGIN(TRISC2_CODE) + LENGTH(TRISC2_CODE), LENGTH = 32K
    TRISC2_GCOV_MEM         : ORIGIN = ORIGIN(TRISC2_LOCAL_DATA_MEM) + LENGTH(TRISC2_LOCAL_DATA_MEM), LENGTH = 8K
    TRISC2_THREAD_LOCAL_MEM : ORIGIN = ORIGIN(TRISC2_GCOV_MEM) + LENGTH(TRISC2_GCOV_MEM), LENGTH = 32K

    NCRISC_CODE             : ORIGIN = ORIGIN(TRISC2_THREAD_LOCAL_MEM) + LENGTH(TRISC2_THREAD_LOCAL_MEM), LENGTH = 48K
    NCRISC_LOCAL_DATA_MEM   : ORIGIN = ORIGIN(NCRISC_CODE) + LENGTH(NCRISC_CODE), LENGTH = 32K
    NCRISC_GCOV_MEM         : ORIGIN = ORIGIN(NCRISC_LOCAL_DATA_MEM) + LENGTH(NCRISC_LOCAL_DATA_MEM), LENGTH = 8K
    NCRISC_THREAD_LOCAL_MEM : ORIGIN = ORIGIN(NCRISC_GCOV_MEM) + LENGTH(NCRISC_GCOV_MEM), LENGTH = 32K


    /* ETH L1 layout */
    ERISC_CODE              : ORIGIN = L1_BASE, LENGTH = 48K
    ERISC_LOCAL_DATA_MEM    : ORIGIN = ORIGIN(ERISC_CODE) + LENGTH(ERISC_CODE), LENGTH = 32K
    ERISC_GCOV_MEM          : ORIGIN = ORIGIN(ERISC_LOCAL_DATA_MEM) + LENGTH(ERISC_LOCAL_DATA_MEM), LENGTH = 8K
    ERISC_THREAD_LOCAL_MEM  : ORIGIN = ORIGIN(ERISC_GCOV_MEM) + LENGTH(ERISC_GCOV_MEM), LENGTH = 32K


    /* (discarded) */
    BRISC_LOADER_INIT_MEM   : ORIGIN = UNDEFINED, LENGTH = UNDEFINED
    BRISC_LOADER_CODE_MEM   : ORIGIN = UNDEFINED, LENGTH = UNDEFINED
    TRISC0_LOADER_INIT_MEM  : ORIGIN = UNDEFINED, LENGTH = UNDEFINED
    TRISC0_LOADER_CODE_MEM  : ORIGIN = UNDEFINED, LENGTH = UNDEFINED
    TRISC1_LOADER_INIT_MEM  : ORIGIN = UNDEFINED, LENGTH = UNDEFINED
    TRISC1_LOADER_CODE_MEM  : ORIGIN = UNDEFINED, LENGTH = UNDEFINED
    TRISC2_LOADER_INIT_MEM  : ORIGIN = UNDEFINED, LENGTH = UNDEFINED
    TRISC2_LOADER_CODE_MEM  : ORIGIN = UNDEFINED, LENGTH = UNDEFINED
    NCRISC_LOADER_INIT_MEM  : ORIGIN = UNDEFINED, LENGTH = UNDEFINED
    NCRISC_LOADER_CODE_MEM  : ORIGIN = UNDEFINED, LENGTH = UNDEFINED
    ERISC_LOADER_INIT_MEM   : ORIGIN = UNDEFINED, LENGTH = UNDEFINED
    ERISC_LOADER_CODE_MEM   : ORIGIN = UNDEFINED, LENGTH = UNDEFINED
}
