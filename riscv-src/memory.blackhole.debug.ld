/*
 * SPDX-FileCopyrightText: (c) 2024 Tenstorrent AI ULC
 *
 * SPDX-License-Identifier: Apache-2.0
 */

LDM_BASE = 0xFFB00000;
BRISC_LDM_LENGTH = 8K;
TRISC_LDM_LENGTH = 4K;
NCRISC_LDM_LENGTH = 8K;
ERISC0_LDM_LENGTH = 8K;
ERISC1_LDM_LENGTH = 8K;
DRISC_LDM_LENGTH = 8K;

L1_BASE = 0x0;
UNDEFINED = 0;

/* Each core's L1 block is [CODE][LOCAL_DATA][GCOV][THREAD_LOCAL], laid out back
 * to back. THREAD_LOCAL backs `thread_local` variables - a fixed, in-range
 * scratch/mailbox window the host can address. The groups are:
 *
 *   Tensix: [BRISC] [TRISCs] [NCRISC] (...) [LDM]
 *   ETH:    [ERISC0] [ERISC1] (...) [LDM]
 *   DRAM:   [DRISC] (...) [LDM]
 *
 * LOADER_INIT regions are undefined, all data is in L1; only stack is in LDM.
 * LOADER_CODE regions are undefined, as there is no NCRISC/ETH IRAM on Blackhole.
 * LOCAL_DATA and CODE regions are spacious because of instrumentation and less optimized kernels.
 * LDM (private memory) is only used for the stack.
 */

MEMORY
{
    /* Private memory layout for each core */
    BRISC_STACK_MEM         : ORIGIN = LDM_BASE, LENGTH = BRISC_LDM_LENGTH
    TRISC0_STACK_MEM        : ORIGIN = LDM_BASE, LENGTH = TRISC_LDM_LENGTH
    TRISC1_STACK_MEM        : ORIGIN = LDM_BASE, LENGTH = TRISC_LDM_LENGTH
    TRISC2_STACK_MEM        : ORIGIN = LDM_BASE, LENGTH = TRISC_LDM_LENGTH
    NCRISC_STACK_MEM        : ORIGIN = LDM_BASE, LENGTH = NCRISC_LDM_LENGTH
    ERISC0_STACK_MEM         : ORIGIN = LDM_BASE, LENGTH = ERISC0_LDM_LENGTH
    ERISC1_STACK_MEM         : ORIGIN = LDM_BASE, LENGTH = ERISC1_LDM_LENGTH
    DRISC_STACK_MEM         : ORIGIN = LDM_BASE, LENGTH = DRISC_LDM_LENGTH


    /* L1 layout. Each core's block ends with its THREAD_LOCAL region. */
    BRISC_CODE              : ORIGIN = L1_BASE, LENGTH = 32K
    BRISC_LOCAL_DATA_MEM    : ORIGIN = ORIGIN(BRISC_CODE) + LENGTH(BRISC_CODE), LENGTH = 32K
    BRISC_GCOV_MEM          : ORIGIN = ORIGIN(BRISC_LOCAL_DATA_MEM) + LENGTH(BRISC_LOCAL_DATA_MEM), LENGTH = 8K
    BRISC_THREAD_LOCAL_MEM  : ORIGIN = ORIGIN(BRISC_GCOV_MEM) + LENGTH(BRISC_GCOV_MEM), LENGTH = 32K

    TRISC0_CODE             : ORIGIN = ORIGIN(BRISC_THREAD_LOCAL_MEM) + LENGTH(BRISC_THREAD_LOCAL_MEM), LENGTH = 32K
    TRISC0_LOCAL_DATA_MEM   : ORIGIN = ORIGIN(TRISC0_CODE) + LENGTH(TRISC0_CODE), LENGTH = 32K
    TRISC0_GCOV_MEM         : ORIGIN = ORIGIN(TRISC0_LOCAL_DATA_MEM) + LENGTH(TRISC0_LOCAL_DATA_MEM), LENGTH = 8K
    TRISC0_THREAD_LOCAL_MEM : ORIGIN = ORIGIN(TRISC0_GCOV_MEM) + LENGTH(TRISC0_GCOV_MEM), LENGTH = 32K

    TRISC1_CODE             : ORIGIN = ORIGIN(TRISC0_THREAD_LOCAL_MEM) + LENGTH(TRISC0_THREAD_LOCAL_MEM), LENGTH = 32K
    TRISC1_LOCAL_DATA_MEM   : ORIGIN = ORIGIN(TRISC1_CODE) + LENGTH(TRISC1_CODE), LENGTH = 32K
    TRISC1_GCOV_MEM         : ORIGIN = ORIGIN(TRISC1_LOCAL_DATA_MEM) + LENGTH(TRISC1_LOCAL_DATA_MEM), LENGTH = 8K
    TRISC1_THREAD_LOCAL_MEM : ORIGIN = ORIGIN(TRISC1_GCOV_MEM) + LENGTH(TRISC1_GCOV_MEM), LENGTH = 32K

    TRISC2_CODE             : ORIGIN = ORIGIN(TRISC1_THREAD_LOCAL_MEM) + LENGTH(TRISC1_THREAD_LOCAL_MEM), LENGTH = 32K
    TRISC2_LOCAL_DATA_MEM   : ORIGIN = ORIGIN(TRISC2_CODE) + LENGTH(TRISC2_CODE), LENGTH = 32K
    TRISC2_GCOV_MEM         : ORIGIN = ORIGIN(TRISC2_LOCAL_DATA_MEM) + LENGTH(TRISC2_LOCAL_DATA_MEM), LENGTH = 8K
    TRISC2_THREAD_LOCAL_MEM : ORIGIN = ORIGIN(TRISC2_GCOV_MEM) + LENGTH(TRISC2_GCOV_MEM), LENGTH = 32K

    NCRISC_CODE             : ORIGIN = ORIGIN(TRISC2_THREAD_LOCAL_MEM) + LENGTH(TRISC2_THREAD_LOCAL_MEM), LENGTH = 32K
    NCRISC_LOCAL_DATA_MEM   : ORIGIN = ORIGIN(NCRISC_CODE) + LENGTH(NCRISC_CODE), LENGTH = 32K
    NCRISC_GCOV_MEM         : ORIGIN = ORIGIN(NCRISC_LOCAL_DATA_MEM) + LENGTH(NCRISC_LOCAL_DATA_MEM), LENGTH = 8K
    NCRISC_THREAD_LOCAL_MEM : ORIGIN = ORIGIN(NCRISC_GCOV_MEM) + LENGTH(NCRISC_GCOV_MEM), LENGTH = 32K


    /* ETH L1 layout */
    ERISC0_CODE             : ORIGIN = L1_BASE, LENGTH = 32K
    ERISC0_LOCAL_DATA_MEM   : ORIGIN = ORIGIN(ERISC0_CODE) + LENGTH(ERISC0_CODE), LENGTH = 32K
    ERISC0_GCOV_MEM         : ORIGIN = ORIGIN(ERISC0_LOCAL_DATA_MEM) + LENGTH(ERISC0_LOCAL_DATA_MEM), LENGTH = 8K
    ERISC0_THREAD_LOCAL_MEM : ORIGIN = ORIGIN(ERISC0_GCOV_MEM) + LENGTH(ERISC0_GCOV_MEM), LENGTH = 32K

    ERISC1_CODE             : ORIGIN = ORIGIN(ERISC0_THREAD_LOCAL_MEM) + LENGTH(ERISC0_THREAD_LOCAL_MEM), LENGTH = 32K
    ERISC1_LOCAL_DATA_MEM   : ORIGIN = ORIGIN(ERISC1_CODE) + LENGTH(ERISC1_CODE), LENGTH = 32K
    ERISC1_GCOV_MEM         : ORIGIN = ORIGIN(ERISC1_LOCAL_DATA_MEM) + LENGTH(ERISC1_LOCAL_DATA_MEM), LENGTH = 8K
    ERISC1_THREAD_LOCAL_MEM : ORIGIN = ORIGIN(ERISC1_GCOV_MEM) + LENGTH(ERISC1_GCOV_MEM), LENGTH = 32K


    /* DRAM L1 layout */
    DRISC_CODE              : ORIGIN = L1_BASE, LENGTH = 32K
    DRISC_LOCAL_DATA_MEM    : ORIGIN = ORIGIN(DRISC_CODE) + LENGTH(DRISC_CODE), LENGTH = 32K
    DRISC_GCOV_MEM          : ORIGIN = ORIGIN(DRISC_LOCAL_DATA_MEM) + LENGTH(DRISC_LOCAL_DATA_MEM), LENGTH = 8K
    DRISC_THREAD_LOCAL_MEM  : ORIGIN = ORIGIN(DRISC_GCOV_MEM) + LENGTH(DRISC_GCOV_MEM), LENGTH = 32K


    /* (discarded) */
    BRISC_LOADER_INIT_MEM   : ORIGIN = UNDEFINED, LENGTH = UNDEFINED
    BRISC_LOADER_CODE_MEM   : ORIGIN = UNDEFINED, LENGTH = UNDEFINED
    TRISC0_LOADER_INIT_MEM  : ORIGIN = UNDEFINED, LENGTH = UNDEFINED
    TRISC0_LOADER_CODE_MEM  : ORIGIN = UNDEFINED, LENGTH = UNDEFINED
    TRISC1_LOADER_INIT_MEM  : ORIGIN = UNDEFINED, LENGTH = UNDEFINED
    TRISC1_LOADER_CODE_MEM  : ORIGIN = UNDEFINED, LENGTH = UNDEFINED
    TRISC2_LOADER_INIT_MEM  : ORIGIN = UNDEFINED, LENGTH = UNDEFINED
    TRISC2_LOADER_CODE_MEM  : ORIGIN = UNDEFINED, LENGTH = UNDEFINED
    NCRISC_LOADER_INIT_MEM  : ORIGIN = UNDEFINED, LENGTH = UNDEFINED
    NCRISC_LOADER_CODE_MEM  : ORIGIN = UNDEFINED, LENGTH = UNDEFINED
    ERISC0_LOADER_INIT_MEM  : ORIGIN = UNDEFINED, LENGTH = UNDEFINED
    ERISC0_LOADER_CODE_MEM  : ORIGIN = UNDEFINED, LENGTH = UNDEFINED
    ERISC1_LOADER_INIT_MEM  : ORIGIN = UNDEFINED, LENGTH = UNDEFINED
    ERISC1_LOADER_CODE_MEM  : ORIGIN = UNDEFINED, LENGTH = UNDEFINED
    DRISC_LOADER_INIT_MEM   : ORIGIN = UNDEFINED, LENGTH = UNDEFINED
    DRISC_LOADER_CODE_MEM   : ORIGIN = UNDEFINED, LENGTH = UNDEFINED
}
