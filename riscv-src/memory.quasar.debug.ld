/*
 * SPDX-FileCopyrightText: (c) 2026 Tenstorrent AI ULC
 *
 * SPDX-License-Identifier: Apache-2.0
 */

/* Each TRISC's LDM has an 8K window in its NEO's local registers, but only the
 * first 4K (TRISC0/3) or 2K (TRISC1/2) are backed by RAM (Quasar RTL:
 * tt_instrn_engine.sv, LOCAL_MEM_SIZE_BYTES).
 */
TRISC0_LDM_BASE = 0x00802000;
TRISC1_LDM_BASE = 0x00804000;
TRISC2_LDM_BASE = 0x00806000;
TRISC3_LDM_BASE = 0x00808000;
TRISC0_LDM_LENGTH = 4K;
TRISC1_LDM_LENGTH = 2K;
TRISC2_LDM_LENGTH = 2K;
TRISC3_LDM_LENGTH = 4K;

L1_BASE = 0x0;
UNDEFINED = 0;

/* Each TRISC's L1 block is [CODE][LOCAL_DATA][GCOV][THREAD_LOCAL], laid out back
 * to back. THREAD_LOCAL backs `thread_local` variables - a fixed, in-range
 * scratch/mailbox window the host can address. The groups are:
 *
 *   Tensix: [TRISCs] [ROCKETs] (...) [LDM]
 *
 * Every NEO has its own TRISC0-3 and a TRISC's LDM is at the same address in
 * every NEO, so an ELF built for a TRISC runs on any NEO. L1 is shared, so it
 * runs on one NEO at a time.
 * Rocket cores have no private memory, so their L1 block holds the stack too:
 * [CODE][LOCAL_DATA][STACK][GCOV][THREAD_LOCAL].
 * LOADER_INIT regions are undefined for every core, as no data is in LDM.
 * LOADER_CODE regions are undefined for every core, as there is no IRAM on Quasar.
 * LOCAL_DATA and CODE regions are spacious because of instrumentation and less optimized kernels.
 * LDM (private memory) is only used for the stack.
 */

MEMORY
{
    /* Private memory layout for each core */
    TRISC0_STACK_MEM         : ORIGIN = TRISC0_LDM_BASE, LENGTH = TRISC0_LDM_LENGTH
    TRISC1_STACK_MEM         : ORIGIN = TRISC1_LDM_BASE, LENGTH = TRISC1_LDM_LENGTH
    TRISC2_STACK_MEM         : ORIGIN = TRISC2_LDM_BASE, LENGTH = TRISC2_LDM_LENGTH
    TRISC3_STACK_MEM         : ORIGIN = TRISC3_LDM_BASE, LENGTH = TRISC3_LDM_LENGTH


    /* L1 layout. Each core's block ends with its THREAD_LOCAL region. */
    TRISC0_CODE              : ORIGIN = L1_BASE, LENGTH = 48K
    TRISC0_LOCAL_DATA_MEM    : ORIGIN = ORIGIN(TRISC0_CODE) + LENGTH(TRISC0_CODE), LENGTH = 32K
    TRISC0_GCOV_MEM          : ORIGIN = ORIGIN(TRISC0_LOCAL_DATA_MEM) + LENGTH(TRISC0_LOCAL_DATA_MEM), LENGTH = 8K
    TRISC0_THREAD_LOCAL_MEM  : ORIGIN = ORIGIN(TRISC0_GCOV_MEM) + LENGTH(TRISC0_GCOV_MEM), LENGTH = 32K

    TRISC1_CODE              : ORIGIN = ORIGIN(TRISC0_THREAD_LOCAL_MEM) + LENGTH(TRISC0_THREAD_LOCAL_MEM), LENGTH = 48K
    TRISC1_LOCAL_DATA_MEM    : ORIGIN = ORIGIN(TRISC1_CODE) + LENGTH(TRISC1_CODE), LENGTH = 32K
    TRISC1_GCOV_MEM          : ORIGIN = ORIGIN(TRISC1_LOCAL_DATA_MEM) + LENGTH(TRISC1_LOCAL_DATA_MEM), LENGTH = 8K
    TRISC1_THREAD_LOCAL_MEM  : ORIGIN = ORIGIN(TRISC1_GCOV_MEM) + LENGTH(TRISC1_GCOV_MEM), LENGTH = 32K

    TRISC2_CODE              : ORIGIN = ORIGIN(TRISC1_THREAD_LOCAL_MEM) + LENGTH(TRISC1_THREAD_LOCAL_MEM), LENGTH = 48K
    TRISC2_LOCAL_DATA_MEM    : ORIGIN = ORIGIN(TRISC2_CODE) + LENGTH(TRISC2_CODE), LENGTH = 32K
    TRISC2_GCOV_MEM          : ORIGIN = ORIGIN(TRISC2_LOCAL_DATA_MEM) + LENGTH(TRISC2_LOCAL_DATA_MEM), LENGTH = 8K
    TRISC2_THREAD_LOCAL_MEM  : ORIGIN = ORIGIN(TRISC2_GCOV_MEM) + LENGTH(TRISC2_GCOV_MEM), LENGTH = 32K

    TRISC3_CODE              : ORIGIN = ORIGIN(TRISC2_THREAD_LOCAL_MEM) + LENGTH(TRISC2_THREAD_LOCAL_MEM), LENGTH = 48K
    TRISC3_LOCAL_DATA_MEM    : ORIGIN = ORIGIN(TRISC3_CODE) + LENGTH(TRISC3_CODE), LENGTH = 32K
    TRISC3_GCOV_MEM          : ORIGIN = ORIGIN(TRISC3_LOCAL_DATA_MEM) + LENGTH(TRISC3_LOCAL_DATA_MEM), LENGTH = 8K
    TRISC3_THREAD_LOCAL_MEM  : ORIGIN = ORIGIN(TRISC3_GCOV_MEM) + LENGTH(TRISC3_GCOV_MEM), LENGTH = 32K

    ROCKET0_CODE             : ORIGIN = ORIGIN(TRISC3_THREAD_LOCAL_MEM) + LENGTH(TRISC3_THREAD_LOCAL_MEM), LENGTH = 48K
    ROCKET0_LOCAL_DATA_MEM   : ORIGIN = ORIGIN(ROCKET0_CODE) + LENGTH(ROCKET0_CODE), LENGTH = 32K
    ROCKET0_STACK_MEM        : ORIGIN = ORIGIN(ROCKET0_LOCAL_DATA_MEM) + LENGTH(ROCKET0_LOCAL_DATA_MEM), LENGTH = 8K
    ROCKET0_GCOV_MEM         : ORIGIN = ORIGIN(ROCKET0_STACK_MEM) + LENGTH(ROCKET0_STACK_MEM), LENGTH = 8K
    ROCKET0_THREAD_LOCAL_MEM : ORIGIN = ORIGIN(ROCKET0_GCOV_MEM) + LENGTH(ROCKET0_GCOV_MEM), LENGTH = 32K

    ROCKET1_CODE             : ORIGIN = ORIGIN(ROCKET0_THREAD_LOCAL_MEM) + LENGTH(ROCKET0_THREAD_LOCAL_MEM), LENGTH = 48K
    ROCKET1_LOCAL_DATA_MEM   : ORIGIN = ORIGIN(ROCKET1_CODE) + LENGTH(ROCKET1_CODE), LENGTH = 32K
    ROCKET1_STACK_MEM        : ORIGIN = ORIGIN(ROCKET1_LOCAL_DATA_MEM) + LENGTH(ROCKET1_LOCAL_DATA_MEM), LENGTH = 8K
    ROCKET1_GCOV_MEM         : ORIGIN = ORIGIN(ROCKET1_STACK_MEM) + LENGTH(ROCKET1_STACK_MEM), LENGTH = 8K
    ROCKET1_THREAD_LOCAL_MEM : ORIGIN = ORIGIN(ROCKET1_GCOV_MEM) + LENGTH(ROCKET1_GCOV_MEM), LENGTH = 32K

    ROCKET2_CODE             : ORIGIN = ORIGIN(ROCKET1_THREAD_LOCAL_MEM) + LENGTH(ROCKET1_THREAD_LOCAL_MEM), LENGTH = 48K
    ROCKET2_LOCAL_DATA_MEM   : ORIGIN = ORIGIN(ROCKET2_CODE) + LENGTH(ROCKET2_CODE), LENGTH = 32K
    ROCKET2_STACK_MEM        : ORIGIN = ORIGIN(ROCKET2_LOCAL_DATA_MEM) + LENGTH(ROCKET2_LOCAL_DATA_MEM), LENGTH = 8K
    ROCKET2_GCOV_MEM         : ORIGIN = ORIGIN(ROCKET2_STACK_MEM) + LENGTH(ROCKET2_STACK_MEM), LENGTH = 8K
    ROCKET2_THREAD_LOCAL_MEM : ORIGIN = ORIGIN(ROCKET2_GCOV_MEM) + LENGTH(ROCKET2_GCOV_MEM), LENGTH = 32K

    ROCKET3_CODE             : ORIGIN = ORIGIN(ROCKET2_THREAD_LOCAL_MEM) + LENGTH(ROCKET2_THREAD_LOCAL_MEM), LENGTH = 48K
    ROCKET3_LOCAL_DATA_MEM   : ORIGIN = ORIGIN(ROCKET3_CODE) + LENGTH(ROCKET3_CODE), LENGTH = 32K
    ROCKET3_STACK_MEM        : ORIGIN = ORIGIN(ROCKET3_LOCAL_DATA_MEM) + LENGTH(ROCKET3_LOCAL_DATA_MEM), LENGTH = 8K
    ROCKET3_GCOV_MEM         : ORIGIN = ORIGIN(ROCKET3_STACK_MEM) + LENGTH(ROCKET3_STACK_MEM), LENGTH = 8K
    ROCKET3_THREAD_LOCAL_MEM : ORIGIN = ORIGIN(ROCKET3_GCOV_MEM) + LENGTH(ROCKET3_GCOV_MEM), LENGTH = 32K

    ROCKET4_CODE             : ORIGIN = ORIGIN(ROCKET3_THREAD_LOCAL_MEM) + LENGTH(ROCKET3_THREAD_LOCAL_MEM), LENGTH = 48K
    ROCKET4_LOCAL_DATA_MEM   : ORIGIN = ORIGIN(ROCKET4_CODE) + LENGTH(ROCKET4_CODE), LENGTH = 32K
    ROCKET4_STACK_MEM        : ORIGIN = ORIGIN(ROCKET4_LOCAL_DATA_MEM) + LENGTH(ROCKET4_LOCAL_DATA_MEM), LENGTH = 8K
    ROCKET4_GCOV_MEM         : ORIGIN = ORIGIN(ROCKET4_STACK_MEM) + LENGTH(ROCKET4_STACK_MEM), LENGTH = 8K
    ROCKET4_THREAD_LOCAL_MEM : ORIGIN = ORIGIN(ROCKET4_GCOV_MEM) + LENGTH(ROCKET4_GCOV_MEM), LENGTH = 32K

    ROCKET5_CODE             : ORIGIN = ORIGIN(ROCKET4_THREAD_LOCAL_MEM) + LENGTH(ROCKET4_THREAD_LOCAL_MEM), LENGTH = 48K
    ROCKET5_LOCAL_DATA_MEM   : ORIGIN = ORIGIN(ROCKET5_CODE) + LENGTH(ROCKET5_CODE), LENGTH = 32K
    ROCKET5_STACK_MEM        : ORIGIN = ORIGIN(ROCKET5_LOCAL_DATA_MEM) + LENGTH(ROCKET5_LOCAL_DATA_MEM), LENGTH = 8K
    ROCKET5_GCOV_MEM         : ORIGIN = ORIGIN(ROCKET5_STACK_MEM) + LENGTH(ROCKET5_STACK_MEM), LENGTH = 8K
    ROCKET5_THREAD_LOCAL_MEM : ORIGIN = ORIGIN(ROCKET5_GCOV_MEM) + LENGTH(ROCKET5_GCOV_MEM), LENGTH = 32K

    ROCKET6_CODE             : ORIGIN = ORIGIN(ROCKET5_THREAD_LOCAL_MEM) + LENGTH(ROCKET5_THREAD_LOCAL_MEM), LENGTH = 48K
    ROCKET6_LOCAL_DATA_MEM   : ORIGIN = ORIGIN(ROCKET6_CODE) + LENGTH(ROCKET6_CODE), LENGTH = 32K
    ROCKET6_STACK_MEM        : ORIGIN = ORIGIN(ROCKET6_LOCAL_DATA_MEM) + LENGTH(ROCKET6_LOCAL_DATA_MEM), LENGTH = 8K
    ROCKET6_GCOV_MEM         : ORIGIN = ORIGIN(ROCKET6_STACK_MEM) + LENGTH(ROCKET6_STACK_MEM), LENGTH = 8K
    ROCKET6_THREAD_LOCAL_MEM : ORIGIN = ORIGIN(ROCKET6_GCOV_MEM) + LENGTH(ROCKET6_GCOV_MEM), LENGTH = 32K

    ROCKET7_CODE             : ORIGIN = ORIGIN(ROCKET6_THREAD_LOCAL_MEM) + LENGTH(ROCKET6_THREAD_LOCAL_MEM), LENGTH = 48K
    ROCKET7_LOCAL_DATA_MEM   : ORIGIN = ORIGIN(ROCKET7_CODE) + LENGTH(ROCKET7_CODE), LENGTH = 32K
    ROCKET7_STACK_MEM        : ORIGIN = ORIGIN(ROCKET7_LOCAL_DATA_MEM) + LENGTH(ROCKET7_LOCAL_DATA_MEM), LENGTH = 8K
    ROCKET7_GCOV_MEM         : ORIGIN = ORIGIN(ROCKET7_STACK_MEM) + LENGTH(ROCKET7_STACK_MEM), LENGTH = 8K
    ROCKET7_THREAD_LOCAL_MEM : ORIGIN = ORIGIN(ROCKET7_GCOV_MEM) + LENGTH(ROCKET7_GCOV_MEM), LENGTH = 32K


    /* (discarded) */
    TRISC0_LOADER_INIT_MEM   : ORIGIN = UNDEFINED, LENGTH = UNDEFINED
    TRISC0_LOADER_CODE_MEM   : ORIGIN = UNDEFINED, LENGTH = UNDEFINED
    TRISC1_LOADER_INIT_MEM   : ORIGIN = UNDEFINED, LENGTH = UNDEFINED
    TRISC1_LOADER_CODE_MEM   : ORIGIN = UNDEFINED, LENGTH = UNDEFINED
    TRISC2_LOADER_INIT_MEM   : ORIGIN = UNDEFINED, LENGTH = UNDEFINED
    TRISC2_LOADER_CODE_MEM   : ORIGIN = UNDEFINED, LENGTH = UNDEFINED
    TRISC3_LOADER_INIT_MEM   : ORIGIN = UNDEFINED, LENGTH = UNDEFINED
    TRISC3_LOADER_CODE_MEM   : ORIGIN = UNDEFINED, LENGTH = UNDEFINED
    ROCKET0_LOADER_INIT_MEM  : ORIGIN = UNDEFINED, LENGTH = UNDEFINED
    ROCKET0_LOADER_CODE_MEM  : ORIGIN = UNDEFINED, LENGTH = UNDEFINED
    ROCKET1_LOADER_INIT_MEM  : ORIGIN = UNDEFINED, LENGTH = UNDEFINED
    ROCKET1_LOADER_CODE_MEM  : ORIGIN = UNDEFINED, LENGTH = UNDEFINED
    ROCKET2_LOADER_INIT_MEM  : ORIGIN = UNDEFINED, LENGTH = UNDEFINED
    ROCKET2_LOADER_CODE_MEM  : ORIGIN = UNDEFINED, LENGTH = UNDEFINED
    ROCKET3_LOADER_INIT_MEM  : ORIGIN = UNDEFINED, LENGTH = UNDEFINED
    ROCKET3_LOADER_CODE_MEM  : ORIGIN = UNDEFINED, LENGTH = UNDEFINED
    ROCKET4_LOADER_INIT_MEM  : ORIGIN = UNDEFINED, LENGTH = UNDEFINED
    ROCKET4_LOADER_CODE_MEM  : ORIGIN = UNDEFINED, LENGTH = UNDEFINED
    ROCKET5_LOADER_INIT_MEM  : ORIGIN = UNDEFINED, LENGTH = UNDEFINED
    ROCKET5_LOADER_CODE_MEM  : ORIGIN = UNDEFINED, LENGTH = UNDEFINED
    ROCKET6_LOADER_INIT_MEM  : ORIGIN = UNDEFINED, LENGTH = UNDEFINED
    ROCKET6_LOADER_CODE_MEM  : ORIGIN = UNDEFINED, LENGTH = UNDEFINED
    ROCKET7_LOADER_INIT_MEM  : ORIGIN = UNDEFINED, LENGTH = UNDEFINED
    ROCKET7_LOADER_CODE_MEM  : ORIGIN = UNDEFINED, LENGTH = UNDEFINED
}
