/*
 * SPDX-FileCopyrightText: (c) 2024 Tenstorrent AI ULC
 *
 * SPDX-License-Identifier: Apache-2.0
 */

LDM_BASE = 0xFFB00000;
BRISC_LDM_LENGTH = 8K;
TRISC_LDM_LENGTH = 4K;
NCRISC_LDM_LENGTH = 8K;
ERISC0_LDM_LENGTH = 8K;
ERISC1_LDM_LENGTH = 8K;
DRISC_LDM_LENGTH = 8K;

L1_BASE = 0x0;
UNDEFINED = 0;

/* Each core's L1 block ends with its THREAD_LOCAL region, which backs
 * `thread_local` variables - a fixed, in-range scratch/mailbox window the host
 * can address. The groups are:
 *
 *   Tensix: [BRISC] [TRISCs] [NCRISC] (...) [LDM]
 *   ETH:    [ERISC0] [ERISC1] (...) [LDM]
 *   DRAM:   [DRISC] (...) [LDM]
 *
 * LOADER_INIT regions are defined for every core, as the data segment resides in LDM.
 * LOADER_CODE regions are undefined for all cores; there is no IRAM on Blackhole.
 * GCOV region is left undefined for obvious reasons.
 * LDM (private memory) is only used for the stack and the data segment.
 */

MEMORY
{
    /* Private memory layout for each core */
    BRISC_LOCAL_DATA_MEM    : ORIGIN = LDM_BASE, LENGTH = 6K
    BRISC_STACK_MEM         : ORIGIN = ORIGIN(BRISC_LOCAL_DATA_MEM) + LENGTH(BRISC_LOCAL_DATA_MEM), LENGTH = BRISC_LDM_LENGTH - LENGTH(BRISC_LOCAL_DATA_MEM)

    TRISC0_LOCAL_DATA_MEM   : ORIGIN = LDM_BASE, LENGTH = 3584
    TRISC0_STACK_MEM        : ORIGIN = ORIGIN(TRISC0_LOCAL_DATA_MEM) + LENGTH(TRISC0_LOCAL_DATA_MEM), LENGTH = TRISC_LDM_LENGTH - LENGTH(TRISC0_LOCAL_DATA_MEM)

    TRISC1_LOCAL_DATA_MEM   : ORIGIN = LDM_BASE, LENGTH = 3584
    TRISC1_STACK_MEM        : ORIGIN = ORIGIN(TRISC1_LOCAL_DATA_MEM) + LENGTH(TRISC1_LOCAL_DATA_MEM), LENGTH = TRISC_LDM_LENGTH - LENGTH(TRISC1_LOCAL_DATA_MEM)

    TRISC2_LOCAL_DATA_MEM   : ORIGIN = LDM_BASE, LENGTH = 3584
    TRISC2_STACK_MEM        : ORIGIN = ORIGIN(TRISC2_LOCAL_DATA_MEM) + LENGTH(TRISC2_LOCAL_DATA_MEM), LENGTH = TRISC_LDM_LENGTH - LENGTH(TRISC2_LOCAL_DATA_MEM)

    NCRISC_LOCAL_DATA_MEM   : ORIGIN = LDM_BASE, LENGTH = 6K
    NCRISC_STACK_MEM        : ORIGIN = ORIGIN(NCRISC_LOCAL_DATA_MEM) + LENGTH(NCRISC_LOCAL_DATA_MEM), LENGTH = NCRISC_LDM_LENGTH - LENGTH(NCRISC_LOCAL_DATA_MEM)

    ERISC0_LOCAL_DATA_MEM    : ORIGIN = LDM_BASE, LENGTH = 6K
    ERISC0_STACK_MEM         : ORIGIN = ORIGIN(ERISC0_LOCAL_DATA_MEM) + LENGTH(ERISC0_LOCAL_DATA_MEM), LENGTH = ERISC0_LDM_LENGTH - LENGTH(ERISC0_LOCAL_DATA_MEM)

    ERISC1_LOCAL_DATA_MEM    : ORIGIN = LDM_BASE, LENGTH = 6K
    ERISC1_STACK_MEM         : ORIGIN = ORIGIN(ERISC1_LOCAL_DATA_MEM) + LENGTH(ERISC1_LOCAL_DATA_MEM), LENGTH = ERISC1_LDM_LENGTH - LENGTH(ERISC1_LOCAL_DATA_MEM)

    DRISC_LOCAL_DATA_MEM    : ORIGIN = LDM_BASE, LENGTH = 3K
    DRISC_STACK_MEM         : ORIGIN = ORIGIN(DRISC_LOCAL_DATA_MEM) + LENGTH(DRISC_LOCAL_DATA_MEM), LENGTH = DRISC_LDM_LENGTH - LENGTH(DRISC_LOCAL_DATA_MEM)


    /* L1 layout. Each core's block ends with its THREAD_LOCAL region. */
    BRISC_CODE              : ORIGIN = L1_BASE, LENGTH = 16K
    BRISC_LOADER_INIT_MEM   : ORIGIN = ORIGIN(BRISC_CODE) + LENGTH(BRISC_CODE), LENGTH = BRISC_LDM_LENGTH
    BRISC_THREAD_LOCAL_MEM  : ORIGIN = ORIGIN(BRISC_LOADER_INIT_MEM) + LENGTH(BRISC_LOADER_INIT_MEM), LENGTH = 16K

    TRISC0_CODE             : ORIGIN = ORIGIN(BRISC_THREAD_LOCAL_MEM) + LENGTH(BRISC_THREAD_LOCAL_MEM), LENGTH = 16K
    TRISC0_LOADER_INIT_MEM  : ORIGIN = ORIGIN(TRISC0_CODE) + LENGTH(TRISC0_CODE), LENGTH = TRISC_LDM_LENGTH
    TRISC0_THREAD_LOCAL_MEM : ORIGIN = ORIGIN(TRISC0_LOADER_INIT_MEM) + LENGTH(TRISC0_LOADER_INIT_MEM), LENGTH = 16K

    TRISC1_CODE             : ORIGIN = ORIGIN(TRISC0_THREAD_LOCAL_MEM) + LENGTH(TRISC0_THREAD_LOCAL_MEM), LENGTH = 16K
    TRISC1_LOADER_INIT_MEM  : ORIGIN = ORIGIN(TRISC1_CODE) + LENGTH(TRISC1_CODE), LENGTH = TRISC_LDM_LENGTH
    TRISC1_THREAD_LOCAL_MEM : ORIGIN = ORIGIN(TRISC1_LOADER_INIT_MEM) + LENGTH(TRISC1_LOADER_INIT_MEM), LENGTH = 16K

    TRISC2_CODE             : ORIGIN = ORIGIN(TRISC1_THREAD_LOCAL_MEM) + LENGTH(TRISC1_THREAD_LOCAL_MEM), LENGTH = 16K
    TRISC2_LOADER_INIT_MEM  : ORIGIN = ORIGIN(TRISC2_CODE) + LENGTH(TRISC2_CODE), LENGTH = TRISC_LDM_LENGTH
    TRISC2_THREAD_LOCAL_MEM : ORIGIN = ORIGIN(TRISC2_LOADER_INIT_MEM) + LENGTH(TRISC2_LOADER_INIT_MEM), LENGTH = 16K

    NCRISC_CODE             : ORIGIN = ORIGIN(TRISC2_THREAD_LOCAL_MEM) + LENGTH(TRISC2_THREAD_LOCAL_MEM), LENGTH = 16K
    NCRISC_LOADER_INIT_MEM  : ORIGIN = ORIGIN(NCRISC_CODE) + LENGTH(NCRISC_CODE), LENGTH = NCRISC_LDM_LENGTH
    NCRISC_THREAD_LOCAL_MEM : ORIGIN = ORIGIN(NCRISC_LOADER_INIT_MEM) + LENGTH(NCRISC_LOADER_INIT_MEM), LENGTH = 16K


    /* ETH L1 layout */
    ERISC0_CODE             : ORIGIN = L1_BASE, LENGTH = 16K
    ERISC0_LOADER_INIT_MEM  : ORIGIN = ORIGIN(ERISC0_CODE) + LENGTH(ERISC0_CODE), LENGTH = ERISC0_LDM_LENGTH
    ERISC0_THREAD_LOCAL_MEM : ORIGIN = ORIGIN(ERISC0_LOADER_INIT_MEM) + LENGTH(ERISC0_LOADER_INIT_MEM), LENGTH = 16K

    ERISC1_CODE             : ORIGIN = ORIGIN(ERISC0_THREAD_LOCAL_MEM) + LENGTH(ERISC0_THREAD_LOCAL_MEM), LENGTH = 16K
    ERISC1_LOADER_INIT_MEM  : ORIGIN = ORIGIN(ERISC1_CODE) + LENGTH(ERISC1_CODE), LENGTH = ERISC1_LDM_LENGTH
    ERISC1_THREAD_LOCAL_MEM : ORIGIN = ORIGIN(ERISC1_LOADER_INIT_MEM) + LENGTH(ERISC1_LOADER_INIT_MEM), LENGTH = 16K


    /* DRAM L1 layout */
    DRISC_CODE              : ORIGIN = L1_BASE, LENGTH = 16K
    DRISC_LOADER_INIT_MEM   : ORIGIN = ORIGIN(DRISC_CODE) + LENGTH(DRISC_CODE), LENGTH = DRISC_LDM_LENGTH
    DRISC_THREAD_LOCAL_MEM  : ORIGIN = ORIGIN(DRISC_LOADER_INIT_MEM) + LENGTH(DRISC_LOADER_INIT_MEM), LENGTH = 16K


    /* (discarded) */
    BRISC_LOADER_CODE_MEM   : ORIGIN = UNDEFINED, LENGTH = UNDEFINED
    BRISC_GCOV_MEM          : ORIGIN = UNDEFINED, LENGTH = UNDEFINED

    TRISC0_LOADER_CODE_MEM  : ORIGIN = UNDEFINED, LENGTH = UNDEFINED
    TRISC0_GCOV_MEM         : ORIGIN = UNDEFINED, LENGTH = UNDEFINED

    TRISC1_LOADER_CODE_MEM  : ORIGIN = UNDEFINED, LENGTH = UNDEFINED
    TRISC1_GCOV_MEM         : ORIGIN = UNDEFINED, LENGTH = UNDEFINED

    TRISC2_LOADER_CODE_MEM  : ORIGIN = UNDEFINED, LENGTH = UNDEFINED
    TRISC2_GCOV_MEM         : ORIGIN = UNDEFINED, LENGTH = UNDEFINED

    NCRISC_LOADER_CODE_MEM  : ORIGIN = UNDEFINED, LENGTH = UNDEFINED
    NCRISC_GCOV_MEM         : ORIGIN = UNDEFINED, LENGTH = UNDEFINED

    ERISC0_LOADER_CODE_MEM  : ORIGIN = UNDEFINED, LENGTH = UNDEFINED
    ERISC0_GCOV_MEM         : ORIGIN = UNDEFINED, LENGTH = UNDEFINED

    ERISC1_LOADER_CODE_MEM  : ORIGIN = UNDEFINED, LENGTH = UNDEFINED
    ERISC1_GCOV_MEM         : ORIGIN = UNDEFINED, LENGTH = UNDEFINED

    DRISC_LOADER_CODE_MEM   : ORIGIN = UNDEFINED, LENGTH = UNDEFINED
    DRISC_GCOV_MEM          : ORIGIN = UNDEFINED, LENGTH = UNDEFINED
}
