/*
 * SPDX-FileCopyrightText: (c) 2024 Tenstorrent AI ULC
 *
 * SPDX-License-Identifier: Apache-2.0
 */
MEMORY
{
    BRISC_STACK_MEM : ORIGIN = 0xFFB00000, LENGTH = 4K
    TRISC0_STACK_MEM : ORIGIN = 0xFFB00000, LENGTH = 2K
    TRISC1_STACK_MEM : ORIGIN = 0xFFB00000, LENGTH = 2K
    TRISC2_STACK_MEM : ORIGIN = 0xFFB00000, LENGTH = 2K
    NCRISC_STACK_MEM : ORIGIN = 0xFFB00000, LENGTH = 4K
    
    BRISC_CODE : ORIGIN = 2048 + 512, LENGTH = 16K
    TRISC0_CODE : ORIGIN = ORIGIN(BRISC_CODE) + LENGTH(BRISC_CODE), LENGTH = 16K
    TRISC1_CODE : ORIGIN = ORIGIN(TRISC0_CODE) + LENGTH(TRISC0_CODE), LENGTH = 16K
    TRISC2_CODE : ORIGIN = ORIGIN(TRISC1_CODE) + LENGTH(TRISC1_CODE), LENGTH = 16K
    NCRISC_CODE : ORIGIN = ORIGIN(TRISC2_CODE) + LENGTH(TRISC2_CODE), LENGTH = 16K

    BRISC_DATA_MEM : ORIGIN = ORIGIN(NCRISC_CODE) + LENGTH(NCRISC_CODE), LENGTH = 4K
    TRISC0_DATA_MEM : ORIGIN = ORIGIN(BRISC_DATA_MEM) + LENGTH(BRISC_DATA_MEM), LENGTH = 4K
    TRISC1_DATA_MEM : ORIGIN = ORIGIN(TRISC0_DATA_MEM) + LENGTH(TRISC0_DATA_MEM), LENGTH = 4K
    TRISC2_DATA_MEM : ORIGIN = ORIGIN(TRISC1_DATA_MEM) + LENGTH(TRISC1_DATA_MEM), LENGTH = 4K
    NCRISC_DATA_MEM : ORIGIN = ORIGIN(TRISC2_DATA_MEM) + LENGTH(TRISC2_DATA_MEM), LENGTH = 4K

    BRISC_LOADER_INIT_MEM : ORIGIN = ORIGIN(NCRISC_DATA_MEM) + LENGTH(NCRISC_DATA_MEM), LENGTH = 4K
    NCRISC_LOADER_INIT_MEM : ORIGIN = ORIGIN(BRISC_LOADER_INIT_MEM) + LENGTH(BRISC_LOADER_INIT_MEM), LENGTH = 4K
    TRISC0_LOADER_INIT_MEM : ORIGIN = ORIGIN(NCRISC_LOADER_INIT_MEM) + LENGTH(NCRISC_LOADER_INIT_MEM), LENGTH = 2K
    TRISC1_LOADER_INIT_MEM : ORIGIN = ORIGIN(TRISC0_LOADER_INIT_MEM) + LENGTH(TRISC0_LOADER_INIT_MEM), LENGTH = 2K
    TRISC2_LOADER_INIT_MEM : ORIGIN = ORIGIN(TRISC1_LOADER_INIT_MEM) + LENGTH(TRISC1_LOADER_INIT_MEM), LENGTH = 2K
    
    BRISC_LOADER_CODE_MEM : ORIGIN = 0, LENGTH = 0
    NCRISC_LOADER_CODE_MEM : ORIGIN = ORIGIN(TRISC2_LOADER_INIT_MEM) + LENGTH(TRISC2_LOADER_INIT_MEM), LENGTH = 16K
    TRISC0_LOADER_CODE_MEM : ORIGIN = 0, LENGTH = 0
    TRISC1_LOADER_CODE_MEM : ORIGIN = 0, LENGTH = 0
    TRISC2_LOADER_CODE_MEM : ORIGIN = 0, LENGTH = 0

    BRISC_GCOV_MEM : ORIGIN = ORIGIN(NCRISC_LOADER_CODE_MEM) + LENGTH(NCRISC_LOADER_CODE_MEM), LENGTH = 4K
    TRISC0_GCOV_MEM : ORIGIN = ORIGIN(BRISC_GCOV_MEM) + LENGTH(BRISC_GCOV_MEM), LENGTH = 4K
    TRISC1_GCOV_MEM : ORIGIN = ORIGIN(TRISC0_GCOV_MEM) + LENGTH(TRISC0_GCOV_MEM), LENGTH = 4K
    TRISC2_GCOV_MEM : ORIGIN = ORIGIN(TRISC1_GCOV_MEM) + LENGTH(TRISC1_GCOV_MEM), LENGTH = 4K
    NCRISC_GCOV_MEM : ORIGIN = ORIGIN(TRISC2_GCOV_MEM) + LENGTH(TRISC2_GCOV_MEM), LENGTH = 4K

    BRISC_GCOV_PTR : ORIGIN = ORIGIN(NCRISC_GCOV_MEM) + LENGTH(NCRISC_GCOV_MEM), LENGTH = 4
    TRISC0_GCOV_PTR : ORIGIN = ORIGIN(BRISC_GCOV_PTR) + LENGTH(BRISC_GCOV_PTR), LENGTH = 4
    TRISC1_GCOV_PTR : ORIGIN = ORIGIN(TRISC0_GCOV_PTR) + LENGTH(TRISC0_GCOV_PTR), LENGTH = 4
    TRISC2_GCOV_PTR : ORIGIN = ORIGIN(TRISC1_GCOV_PTR) + LENGTH(TRISC1_GCOV_PTR), LENGTH = 4
    NCRISC_GCOV_PTR : ORIGIN = ORIGIN(TRISC2_GCOV_PTR) + LENGTH(TRISC2_GCOV_PTR), LENGTH = 4

    BRISC_IMPURE_DATA : ORIGIN = ORIGIN(NCRISC_GCOV_PTR) + LENGTH(NCRISC_GCOV_PTR), LENGTH = 1280
    TRISC0_IMPURE_DATA : ORIGIN = ORIGIN(BRISC_IMPURE_DATA) + LENGTH(BRISC_IMPURE_DATA), LENGTH = 1280
    TRISC1_IMPURE_DATA : ORIGIN = ORIGIN(TRISC0_IMPURE_DATA) + LENGTH(TRISC0_IMPURE_DATA), LENGTH = 1280
    TRISC2_IMPURE_DATA : ORIGIN = ORIGIN(TRISC1_IMPURE_DATA) + LENGTH(TRISC1_IMPURE_DATA), LENGTH = 1280
    NCRISC_IMPURE_DATA : ORIGIN = ORIGIN(TRISC2_IMPURE_DATA) + LENGTH(TRISC2_IMPURE_DATA), LENGTH = 1280

    BRISC_BSS : ORIGIN = ORIGIN(NCRISC_IMPURE_DATA) + LENGTH(NCRISC_IMPURE_DATA), LENGTH = 2K
    TRISC0_BSS : ORIGIN = ORIGIN(BRISC_BSS) + LENGTH(BRISC_BSS), LENGTH = 2K
    TRISC1_BSS : ORIGIN = ORIGIN(TRISC0_BSS) + LENGTH(TRISC0_BSS), LENGTH = 2K
    TRISC2_BSS : ORIGIN = ORIGIN(TRISC1_BSS) + LENGTH(TRISC1_BSS), LENGTH = 2K
    NCRISC_BSS : ORIGIN = ORIGIN(TRISC2_BSS) + LENGTH(TRISC2_BSS), LENGTH = 2K
}
