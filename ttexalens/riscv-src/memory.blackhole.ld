/*
 * SPDX-FileCopyrightText: (c) 2024 Tenstorrent AI ULC
 *
 * SPDX-License-Identifier: Apache-2.0
 */
MEMORY
{
    BRISC_LOCAL_DATA_MEM : ORIGIN = 0xFFB00000, LENGTH = (4 * 1024) - 1024
    TRISC0_LOCAL_DATA_MEM : ORIGIN = 0xFFB00000, LENGTH = (2 * 1024) - 256
    TRISC1_LOCAL_DATA_MEM : ORIGIN = 0xFFB00000, LENGTH = (2 * 1024) - 256
    TRISC2_LOCAL_DATA_MEM : ORIGIN = 0xFFB00000, LENGTH = (2 * 1024) - 768
    NCRISC_LOCAL_DATA_MEM : ORIGIN = 0xFFB00000, LENGTH = (4 * 1024) - 1024
    BRISC_STACK_MEM : ORIGIN = (0xFFB00000 + (4 * 1024) - 1024), LENGTH = 1024
    TRISC0_STACK_MEM : ORIGIN = (0xFFB00000 + (2 * 1024) - 256), LENGTH = 256
    TRISC1_STACK_MEM : ORIGIN = (0xFFB00000 + (2 * 1024) - 256), LENGTH = 256
    TRISC2_STACK_MEM : ORIGIN = (0xFFB00000 + (2 * 1024) - 768), LENGTH = 768
    NCRISC_STACK_MEM : ORIGIN = (0xFFB00000 + (4 * 1024) - 1024), LENGTH = 1024
    BRISC_CODE : ORIGIN = (2048 + 512), LENGTH = (16 * 1024)
    TRISC0_CODE : ORIGIN = ((2048 + 512) + (16 * 1024)), LENGTH = (16 * 1024)
    TRISC1_CODE : ORIGIN = ((2048 + 512) + (16 * 1024) + (16 * 1024)), LENGTH = (16 * 1024)
    TRISC2_CODE : ORIGIN = ((2048 + 512) + (16 * 1024) + (16 * 1024) + (16 * 1024)), LENGTH = (16 * 1024)
    NCRISC_CODE : ORIGIN = ((2048 + 512) + (16 * 1024) + (16 * 1024) + (16 * 1024) + (16 * 1024)), LENGTH = (16 * 1024)
    BRISC_LOADER_INIT_MEM : ORIGIN = 84480, LENGTH = 4 * 1024
    NCRISC_LOADER_INIT_MEM : ORIGIN = (84480 + (4 * 1024)), LENGTH = (4 * 1024)
    TRISC0_LOADER_INIT_MEM : ORIGIN = (84480 + (4 * 1024) + (4 * 1024)), LENGTH = (2 * 1024)
    TRISC1_LOADER_INIT_MEM : ORIGIN = (84480 + (4 * 1024) + (4 * 1024) + (2 * 1024)), LENGTH = (2 * 1024)
    TRISC2_LOADER_INIT_MEM : ORIGIN = (84480 + (4 * 1024) + (4 * 1024) + (2 * 1024) + (2 * 1024)), LENGTH = (2 * 1024)
    BRISC_LOADER_CODE_MEM : ORIGIN = 98816, LENGTH = 0 * 1024
    NCRISC_LOADER_CODE_MEM : ORIGIN = (98816 + (0 * 1024)), LENGTH = (0 * 1024)
    TRISC0_LOADER_CODE_MEM : ORIGIN = (98816 + (0 * 1024) + (0 * 1024)), LENGTH = (0 * 1024)
    TRISC1_LOADER_CODE_MEM : ORIGIN = (98816 + (0 * 1024) + (0 * 1024) + (0 * 1024)), LENGTH = (0 * 1024)
    TRISC2_LOADER_CODE_MEM : ORIGIN = (98816 + (0 * 1024) + (0 * 1024) + (0 * 1024) + (0 * 1024)), LENGTH = (0 * 1024)
    BRISC_GCOV_MEM : ORIGIN = 98816, LENGTH = 8192
    TRISC0_GCOV_MEM : ORIGIN = 98816 + 8192, LENGTH = 8192
    TRISC1_GCOV_MEM : ORIGIN = 98816 + 8192 + 8192, LENGTH = 8192
    TRISC2_GCOV_MEM : ORIGIN = 98816 + 8192 + 8192 + 8192, LENGTH = 8192
    NCRISC_GCOV_MEM : ORIGIN = 98816 + 8192 + 8192 + 8192 + 8192, LENGTH = 8192
    BRISC_GCOV_INFO : ORIGIN = 139776, LENGTH = 4
    TRISC0_GCOV_INFO : ORIGIN = 139776 + 4, LENGTH = 4
    TRISC1_GCOV_INFO : ORIGIN = 139776 + 4 + 4, LENGTH = 4
    TRISC2_GCOV_INFO : ORIGIN = 139776 + 4 + 4 + 4, LENGTH = 4
    NCRISC_GCOV_INFO : ORIGIN = 139776 + 4 + 4 + 4 + 4, LENGTH = 4
    BRISC_IMPURE_DATA : ORIGIN = 139796, LENGTH = 1280
    TRISC0_IMPURE_DATA : ORIGIN = 139796 + 1280, LENGTH = 1280
    TRISC1_IMPURE_DATA : ORIGIN = 139796 + 1280 + 1280, LENGTH = 1280
    TRISC2_IMPURE_DATA : ORIGIN = 139796 + 1280 + 1280 + 1280, LENGTH = 1280
    NCRISC_IMPURE_DATA : ORIGIN = 139796 + 1280 + 1280 + 1280 + 1280, LENGTH = 1280
    BRISC_BSS : ORIGIN = 146196, LENGTH = 1024
    TRISC0_BSS : ORIGIN = 146196 + 1024, LENGTH = 1024
    TRISC1_BSS : ORIGIN = 146196 + 1024 + 1024, LENGTH = 1024
    TRISC2_BSS : ORIGIN = 146196 + 1024 + 1024 + 1024, LENGTH = 1024
    NCRISC_BSS : ORIGIN = 146196 + 1024 + 1024 + 1024 + 1024, LENGTH = 1024
}
